## shell/nuttallite/nuttx/config/build/Kconfig
```kconfig
config FLUXEMU_SHELL_NUTTALLITE
	tristate "FluxEMU NuttX port"
	default n

if FLUXEMU_SHELL_NUTTALLITE
config FLUXEMU_SHELL_NUTTALLITE_PROGNAME
	string "Program name"
	default "fluxemu_shell_nuttallite"

config FLUXEMU_SHELL_NUTTALLITE_PRIORITY
	int "Task priority"
	default 100

config FLUXEMU_SHELL_NUTTALLITE_STACKSIZE
	int "Stack size"
	default 16384
endif
```
